## Config.in
```kconfig
source "$BR2_EXTERNAL_CHIPSEE_BR_PATH/package/testing-kmscube/Config.in"
source "$BR2_EXTERNAL_CHIPSEE_BR_PATH/package/testing-utilities/Config.in"
```

## configs/chipsee_CS10600RA4070P_defconfig
```kconfig
# ##############################################################################
#
# Kconfig with specific configuration to generate a minimal image for this
# specific Chipsee model: PPC-CM4-070 (#CS10600RA4070P)
#
# Based on the default `raspberrypicm4io_64_defconfig` of Buildroot
# `2025.02.03`
#
# ##############################################################################


# ##############################################################################
# From Buildroot's original `raspberrypicm4io_64_defconfig`
# ##############################################################################

BR2_aarch64=y
BR2_cortex_a72=y
BR2_ARM_FPU_VFPV4=y
# Linux headers same as kernel, a 6.12 LTS series
BR2_PACKAGE_HOST_LINUX_HEADERS_CUSTOM_6_12=y
BR2_TOOLCHAIN_BUILDROOT_CXX=y
BR2_GLOBAL_PATCH_DIR="board/raspberrypi/patches"
# BR2_DOWNLOAD_FORCE_CHECK_HASHES=y
BR2_SYSTEM_DHCP="eth0"
BR2_ROOTFS_POST_BUILD_SCRIPT="board/raspberrypicm4io-64/post-build.sh"
BR2_ROOTFS_POST_IMAGE_SCRIPT="board/raspberrypicm4io-64/post-image.sh"
BR2_LINUX_KERNEL=y
BR2_LINUX_KERNEL_CUSTOM_TARBALL=y
BR2_LINUX_KERNEL_CUSTOM_TARBALL_LOCATION="$(call github,raspberrypi,linux,304e1d5171065f013845fc3b8d2866f4bf697f59)/linux-304e1d5171065f013845fc3b8d2866f4bf697f59.tar.gz"
BR2_LINUX_KERNEL_DEFCONFIG="bcm2711"
BR2_LINUX_KERNEL_DTS_SUPPORT=y
BR2_LINUX_KERNEL_INTREE_DTS_NAME="broadcom/bcm2711-rpi-cm4"
BR2_LINUX_KERNEL_NEEDS_HOST_OPENSSL=y
BR2_PACKAGE_BUSYBOX_SHOW_OTHERS=y
BR2_PACKAGE_XZ=y
BR2_PACKAGE_RPI_FIRMWARE=y
BR2_PACKAGE_RPI_FIRMWARE_VARIANT_PI4=y
BR2_PACKAGE_RPI_FIRMWARE_CONFIG_FILE="board/raspberrypicm4io-64/config_cm4io_64bit.txt"
BR2_PACKAGE_KMOD=y
BR2_PACKAGE_KMOD_TOOLS=y
BR2_TARGET_ROOTFS_EXT2=y
BR2_TARGET_ROOTFS_EXT2_4=y
BR2_TARGET_ROOTFS_EXT2_SIZE="120M"
# BR2_TARGET_ROOTFS_TAR is not set
BR2_PACKAGE_HOST_DOSFSTOOLS=y
BR2_PACKAGE_HOST_GENIMAGE=y
BR2_PACKAGE_HOST_KMOD_XZ=y
BR2_PACKAGE_HOST_MTOOLS=y
BR2_PACKAGE_HOST_RASPBERRYPI_USBBOOT=y


# ##############################################################################
# Custom
# ##############################################################################

# Build
BR2_CCACHE=y
BR2_TOOLCHAIN_BUILDROOT_GLIBC=y
BR2_TARGET_TZ_INFO=y

# Root password
# BR2_TARGET_GENERIC_ROOT_PASSWD="hi"

# Required to be able to load modules automatically
BR2_ROOTFS_DEVICE_CREATION_DYNAMIC_EUDEV=y

# Graphics
BR2_PACKAGE_MESA3D=y
BR2_PACKAGE_MESA3D_OPENGL_ES=y
BR2_PACKAGE_MESA3D_OPENGL_EGL=y
BR2_PACKAGE_MESA3D_GALLIUM_DRIVER_V3D=y
BR2_PACKAGE_MESA3D_GALLIUM_DRIVER_VC4=y
BR2_PACKAGE_MESA3D_GALLIUM_DRIVER_KMSRO=y

# Utilities for testing and inspection
BR2_PACKAGE_BASIC_TESTING_UTILITIES=y

# Graphics test
BR2_PACKAGE_TESTING_KMSCUBE=y

# BR2_PACKAGE_EUDEV=y

# Overlays
BR2_ROOTFS_OVERLAY="$(BR2_EXTERNAL_CHIPSEE_BR_PATH)/rootfs_overlay/lib/firmware"
```

## package/chipsee-display/Config.in
```kconfig
config BR2_PACKAGE_CHIPSEE_DISPLAY
	bool "Chipsee display support"
	depends on BR2_LINUX_KERNEL
	help
	  Display pipeline for Chipsee HDMI-to-DPI bridge panels:
	  - Installs a synthetic EDID for the selected display model
	  - Installs broadcast-rgb, which sets Broadcast RGB=Limited 16:235
	    at boot via DRM_IOCTL_MODE_SETPROPERTY

if BR2_PACKAGE_CHIPSEE_DISPLAY

choice
	prompt "Display model"
	default BR2_PACKAGE_CHIPSEE_DISPLAY_CS10600RA4070

config BR2_PACKAGE_CHIPSEE_DISPLAY_CS10600RA4070
	bool "CS10600RA4070 (7\" — 1024x600)"

config BR2_PACKAGE_CHIPSEE_DISPLAY_CS12800RA4101
	bool "CS12800RA4101 (10.1\" — 1280x800)"

endchoice

endif
```

## package/testing-kmscube/Config.in
```kconfig
config BR2_PACKAGE_TESTING_KMSCUBE
    bool "Video test based on KMSCube"
    default n

    # Video test
    select BR2_PACKAGE_KMSCUBE

    help
        Test based on KMSCUBE
```

## package/testing-utilities/Config.in
```kconfig
config BR2_PACKAGE_BASIC_TESTING_UTILITIES
    bool "Basic Testing Utilities"
    default n

    # Network
    select BR2_PACKAGE_DHCPCD

    # SSH Server
    select BR2_PACKAGE_DROPBEAR

    # Nano editor
    select BR2_PACKAGE_NANO if BR2_USE_WCHAR

    # Extra BusyBox
    select BR2_PACKAGE_BUSYBOX_SHOW_OTHERS

    # System representation
    select BR2_PACKAGE_NEOFETCH if BR2_USE_MMU \
        && BR2_PACKAGE_BUSYBOX_SHOW_OTHERS

    # To nicely list hw resources including the serial of the device
    select BR2_PACKAGE_LSHW

    # To extract info from JSON data (Like the one that can be produced by BR2_PACKAGE_LSHW)
    select BR2_PACKAGE_JQ

    # Detailed info (ie. to check HDMI)
    select BR2_PACKAGE_EDID_DECODE
    select BR2_PACKAGE_READ_EDID

    help
        Some utilities to inspect and test the hardware
```
